## Config.in
```kconfig
menu "WT41N0 board options"

config BR2_WT41N0_LOCAL_DIR
	string "directory with local, private files"
	default "$(BR2_EXTERNAL_WT41N0_PATH)/local"
	help
	  Optional files that are copied into the image when present.
	  The directory is ignored by git, so nothing in it is shared.

	    wifi.conf                   wpa_supplicant configuration, only
	                                with BR2_WT41N0_LOCAL_WIFI
	    authorized_keys             ssh public keys for root, and
	    dropbear_ed25519_host_key   a fixed ssh host key, both only
	                                with BR2_WT41N0_LOCAL_SSH

config BR2_WT41N0_LOCAL_WIFI
	bool "build local/wifi.conf into the image"
	help
	  Install wifi.conf from the local directory as
	  /etc/wpa_supplicant.conf, so the unit joins your network at its
	  first boot without any setup on the unit.

	  Off by default: the image then carries no Wi-Fi networks and no
	  passphrase, and networks are added on the unit with Settings,
	  Wi-Fi (they are saved on the eMMC root). Turn it on for your own
	  development images; leave it off for images you hand to others.

config BR2_WT41N0_LOCAL_SSH
	bool "build local/ ssh keys into the image"
	help
	  Install authorized_keys from the local directory as
	  /root/.ssh/authorized_keys and dropbear_ed25519_host_key as the
	  ssh host key, so your key logs in at once and every unit flashed
	  with the image has the same ssh identity.

	  Off by default: root logs in over ssh with the root password
	  (BR2_TARGET_GENERIC_ROOT_PASSWD), and each unit makes its own host
	  key at its first start (kept on the eMMC root). Turn it on for
	  your own development images.

config BR2_WT41N0_ROOT_PASSWD_EXPIRED
	bool "ask for a new root password at the first ssh login"
	default y
	help
	  Mark root's password as expired in /etc/shadow (last change 0),
	  so the first interactive ssh login must choose a new one before
	  it gets a shell; if it does not, the session ends. Use it when
	  the image carries a default password (wt41n0 in the defconfig).

	  Only ssh logins are asked: the consoles (LCD terminal, USB) are
	  root shells without a login. Commands run over ssh without a
	  terminal are not stopped.

config BR2_WT41N0_RNG_SEED
	bool "random seed in the device tree"
	default y
	help
	  Put 64 random bytes from the build machine into the device
	  tree (/chosen/rng-seed). The kernel uses them as initial
	  entropy, so its random number generator is ready at once.

	  Without a seed the generator needs about a minute to collect
	  enough entropy on this board (its only clock source is a
	  32 kHz counter), and ssh does not answer until then.

	  Every boot of one image starts from the same seed, mixed with
	  timing entropy gathered while it runs. Treat the image file
	  as secret anyway: it also holds the ssh host key from local/
	  (and the Wi-Fi passphrase with BR2_WT41N0_LOCAL_WIFI).

choice
	prompt "boot verbosity"
	default BR2_WT41N0_BOOT_VERBOSE
	help
	  How much the unit shows on its LCD while it starts.

config BR2_WT41N0_BOOT_QUIET
	bool "quiet"
	help
	  The loader's progress screen stays until the shell prompt
	  appears. The kernel only prints
	  errors (quiet loglevel=3) and the start-up scripts log to
	  /var/log/boot.log, showing a line on the LCD only when one of
	  them fails.

config BR2_WT41N0_BOOT_VERBOSE
	bool "verbose"
	help
	  Kernel messages (loglevel=7) scroll on the LCD as the system
	  starts, followed by one line per start-up script. The default.

config BR2_WT41N0_BOOT_DEBUG
	bool "debug"
	help
	  Everything: the loader shows its diagnostic screen (image
	  sizes and a register dump), the kernel is built with the LCD
	  low-level debug console and prints from its first instruction
	  (earlyprintk keep_bootcon ignore_loglevel).

endchoice

config BR2_WT41N0_LAUNCHER
	bool "start the launcher on the LCD"
	default y
	depends on BR2_PACKAGE_WT41N0_UI
	help
	  Start the wt41n0-ui launcher (the home screen) on the LCD
	  instead of a root shell. The shell stays available as the
	  Terminal app (on tty2; hold ESC to come back), over ssh and
	  on the USB console.

endmenu

source "$BR2_EXTERNAL_WT41N0_PATH/package/wt41n0-loader/Config.in"
source "$BR2_EXTERNAL_WT41N0_PATH/package/wt41n0-utils/Config.in"
source "$BR2_EXTERNAL_WT41N0_PATH/package/lvgl/Config.in"
source "$BR2_EXTERNAL_WT41N0_PATH/package/wt41n0-ui/Config.in"
```

## package/lvgl/Config.in
```kconfig
config BR2_PACKAGE_LVGL
	bool "lvgl"
	depends on BR2_INSTALL_LIBSTDCPP # its CMake project needs C++
	help
	  LVGL, the Light and Versatile Graphics Library: widgets,
	  styles, fonts and input handling for small displays, built
	  as a shared library with the configuration in lv_conf.h
	  next to this file. Used by wt41n0-ui.

	  https://lvgl.io
```

## package/wt41n0-loader/Config.in
```kconfig
config BR2_PACKAGE_WT41N0_LOADER
	bool "wt41n0-loader"
	help
	  The small loader the Symbol monitor jumps to in place of the
	  stock OS entry point. It turns off the L2 cache, copies the
	  kernel, device tree and initramfs to their run addresses and
	  starts the kernel, listing each step on the LCD. Installed as
	  wt41n0-loader.bin in the images directory, where the post-image
	  script picks it up.
```

## package/wt41n0-ui/Config.in
```kconfig
config BR2_PACKAGE_WT41N0_UI
	bool "wt41n0-ui"
	depends on BR2_INSTALL_LIBSTDCPP # lvgl
	select BR2_PACKAGE_LVGL
	select BR2_PACKAGE_ALSA_LIB	# Settings: volume
	help
	  The WT41N0 launcher and its apps, on LVGL: a home screen
	  driven by the keypad or the touch panel, and the shared
	  library libwt41n0ui the apps build on (display, input,
	  theme, status bar).

if BR2_PACKAGE_WT41N0_UI

config BR2_PACKAGE_WT41N0_UI_EXAMPLE
	bool "example app"
	help
	  Install the example app (src/apps/example), the template
	  for writing new apps, with its home screen tile.

endif

comment "wt41n0-ui needs a toolchain with C++ (for LVGL's build)"
	depends on !BR2_INSTALL_LIBSTDCPP
```

## package/wt41n0-utils/Config.in
```kconfig
config BR2_PACKAGE_WT41N0_UTILS
	bool "wt41n0-utils"
	help
	  Small board tools for the WT41N0:

	    pcmtest         play a test tone or record, straight through
	                    the kernel PCM interface (no ALSA library)
	    wt41n0-fpga     FPGA registers, touch pen level, accessory power
	    wt41n0-survey   collect logs and hardware state (read-only)
	    wt41n0-update   install a new image into the eMMC OS area
	    wt41n0-install-root  write the root filesystem to the eMMC
	    wt41n0-growfs   grow the eMMC root file system to its partition
	    wt41n0-scan     read barcodes from the ring scanner
	    keys            show the keypad layers
```
